/*
 * SPDX-FileCopyrightText: Copyright (c) 2024 Nathan Perry <np@npry.dev>
 * SPDX-License-Identifier: MIT OR Apache-2.0
 */

&xiao_spi {
	status = "okay";

	cs-gpios = <&xiao_d 7 GPIO_ACTIVE_LOW>;

	tmc5240@0 {
		compatible = "adi,tmc5240";
		status = "okay";
		reg = <0>;
		spi-max-frequency = <2000000>;
	};
};
