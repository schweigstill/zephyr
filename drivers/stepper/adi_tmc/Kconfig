## drivers/stepper/adi_tmc/Kconfig
```kconfig
# SPDX-FileCopyrightText: Copyright (c) 2024 Carl Zeiss Meditec AG
# SPDX-FileCopyrightText: Copyright (c) 2026 A. Schweigstill
# SPDX-License-Identifier: Apache-2.0

comment "ADI Trinamic Stepper Drivers"

rsource "bus/Kconfig"

rsource "tmc22xx/Kconfig.tmc22xx"
rsource "tmc50xx/Kconfig.tmc50xx"
rsource "tmc51xx/Kconfig.tmc51xx"
rsource "tmc52xx/Kconfig.tmc52xx"
```

## drivers/stepper/adi_tmc/Kconfig.tmc52xx
```kconfig
# SPDX-FileCopyrightText: Copyright (c) 2025 Prevas A/S; A. Schweigstill
# SPDX-License-Identifier: Apache-2.0

config STEPPER_ADI_TMC52XX
	bool "Activate Trinamic tmc52xx stepper driver"
	depends on DT_HAS_ADI_TMC52XX_ENABLED && STEPPER_ADI_TMC
	select STEPPER_ADI_TMC_UART if $(dt_compat_on_bus,$(DT_COMPAT_ADI_TMC52XX),uart)
	select STEPPER_ADI_TMC_SPI if $(dt_compat_on_bus,$(DT_COMPAT_ADI_TMC52XX),spi)
	default y

config STEPPER_ADI_TMC52XX_DETECT_UNRESPONSIVE
	bool "Detect unresponsive bus"
	depends on STEPPER_ADI_TMC52XX
	default y
	help
	  Report an error if response data heuristically indicates there was a communication
	  failure on the bus

config STEPPER_ADI_TMC52XX_SHADOW
	bool "Enable shadow registers"
	depends on STEPPER_ADI_TMC52XX
	default y
	help
	  Optimize SPI I/O by caching register values in a shadow register file.


module = TMC52XX
module-str = tmc52xx
rsource "Kconfig.tmc_rampgen_template"
```

## drivers/stepper/tmc5240/Kconfig
```kconfig
# SPDX-FileCopyrightText: Copyright (c) 2024 Nathan Perry <np@npry.dev>
# SPDX-License-Identifier: MIT OR Apache-2.0

menuconfig TMC5240_STEPPER
	bool "TMC5240"
	help
	  TMC5240 SPI stepper driver.

config TMC5240_STEPPER_DETECT_UNRESPONSIVE
	bool "Detect unresponsive bus"
	depends on TMC5240_STEPPER
	default y
	help
	  Report an error if response data heuristically indicates there was a communication
	  failure on the bus

config TMC5240_STEPPER_SHADOW
	bool "Enable shadow registers"
	depends on TMC5240_STEPPER
	default y
	help
	  Optimize SPI I/O by caching register values in a shadow register file.

DT_COMPAT_ADI_TMC2540 := "adi,tmc5240"
```

## dts/bindings/stepper/adi,tmc5240.yaml
```yaml
# SPDX-FileCopyrightText: Copyright (c) 2024 Nathan Perry <np@npry.dev>
# SPDX-License-Identifier: MIT OR Apache-2.0

description: TMC5240 stepper driver

compatible: "adi,tmc5240"

include:
  - base.yaml
  - spi-device.yaml

properties: { }
```

## dts/bindings/stepper/adi/adi,tmc524x-base.yaml
```yaml
# SPDX-FileCopyrightText: Copyright (c) 2025 Prevas A/S
# SPDX-FileCopyrightText: Copyright (c) 2026 A. Schweigstill
# SPDX-License-Identifier: Apache-2.0

description: |
  Common properties for Analog Devices TMC524X Stepper Motor Controller

include:
  - name: adi,trinamic-gconf.yaml
    property-allowlist:
      - en-pwm-mode
      - fast-standstill
      - length-step-pulse

properties:
  shaft:
    type: boolean
    description: |
      Inverse motor direction

  clock-frequency:
    type: int
    required: true
    description: |
      The frequency of the clock signal provided to the TMC524X.
      This is used for real world conversion.

      Hint: µstep velocity v[Hz] µsteps / s v[Hz] = v[52xx] * ( fCLK[Hz]/2 / 2^23 )
            where v[52xx] is the value written to the TMC524X.

  sleep-gpios:
    type: phandle-array
    description: |
      Reset/Sleep input SLEEPN pin. This pin has to be set to high in order
      to enable the TMC device. A short low pulse performs a hardware reset.
      Used in conjunction with hw-reset.
      Should be configured as push-pull output (active low).

  hw-reset:
    type: boolean
    description: |
      Perform a complete reset cycle on sleep-gpio. The pin is set to low and
      after a short waiting time set to high. If hw-reset is not set, this
      explicit low->wait->high cycle is omitted and sleep-gpio is set high
      immediately. See chapter "External Reset and Sleep Mode" in the TMC524x
      datasheet.
```

## dts/bindings/stepper/adi/adi,tmc52xx-stepper-drv.yaml
```yaml
# SPDX-FileCopyrightText: Copyright (c) 2025 Jilay Sandeep Pandya
# SPDX-FileCopyrightText: Copyright (c) 2026 A. Schweigstill
# SPDX-License-Identifier: Apache-2.0

compatible: "adi,tmc52xx-stepper-drv"

include:
  - name: stepper-driver.yaml
  - name: adi,trinamic-stallguard.yaml
    property-allowlist:
      - stallguard2-threshold
```

## dts/bindings/stepper/adi/adi,tmc52xx-uart.yaml
```yaml
# SPDX-FileCopyrightText: Copyright (c) 2025 Dipak Shetty, A. Schweigstill
# SPDX-License-Identifier: Apache-2.0

description: |
  Analog Devices TMC52XX Stepper Motor Controller (UART single-wire mode)

  This binding supports the single-wire UART mode where:
  - SWIOP is connected to the MCU's UART TX/RX pin
  - SWION should be connected to half the IO level voltage (1.65V for 3.3V systems)
  - SW_SEL must be HIGH (either via GPIO control or hardwired)

  Example:

    &uart2 {
        current-speed = <115200>;
        status = "okay";

        tmc52xx: tmc52xx {
            compatible = "adi,tmc52xx";
            sw-sel-gpios = <&gpiob 0x01 GPIO_ACTIVE_HIGH>;

            /* Common settings from base binding */
            clock-frequency = <DT_FREQ_M(12)>;
            en-pwm-mode;
            invert-direction;
            micro-step-res = <256>;

            /* ADI TMC ramp generator as well as current settings */
            vstart = <0>;
            vstop = <10>;
            a1 = <1000>;
            v1 = <50000>;
            d1 = <1400>;
            vmax = <200000>;
            amax = <50000>;
            dmax = <700>;
            tzerowait = <100>;
            ihold = <10>;
            irun = <31>;
            iholddelay = <6>;
        };
    };

compatible: "adi,tmc52xx"

include: [uart-device.yaml, "adi,tmc52xx-base.yaml"]

properties:
  sw-sel-gpios:
    type: phandle-array
    description: |
      GPIO connected to the SW_SEL pin of TMC52XX.
      Must be set HIGH for UART mode operation.
      If not provided, it's assumed SW_SEL is hardwired to VCC/HIGH.

  uart-device-addr:
    type: int
    description: |
        UART device address for TMC52XX in UART mode.
        Valid range: 0 - 253
```

## samples/drivers/stepper_tmc5240/sample.yaml
```yaml
sample:
  description: Demo for TMC5240
  name: TMC5240 demo
tests:
  sample.drivers.stepper:
    tags:
      - drivers
      - spi
      - stepper
    integration_platforms:
      - rpi_pico
    depends_on: spi
```
